## CMakeLists.txt
```
cmake_minimum_required(VERSION 3.20.0)

find_package(Zephyr REQUIRED HINTS $ENV{ZEPHYR_BASE})
project(central_min)

if(CONFIG_EMG_NETWORK_SCAN)
  target_sources(app PRIVATE
    src/network_scan.c
  )
else()
  target_sources(app PRIVATE
    src/main.c
    src/custom_client.c
    src/experiment_receiver.c
    src/sync_controller.c
  )
endif()

target_include_directories(app PRIVATE
  ${CMAKE_CURRENT_SOURCE_DIR}/../../common
)
```

## Kconfig
```
source "Kconfig.zephyr"

config EMG_PREEXPERIMENT
	bool "Automatic BLE saturation preexperiment"
	default n

config EMG_POSTEXPERIMENT
	bool "Unified post-preexperiment profile sequence"
	default n

config EMG_NETWORK_SCAN
	bool "BLE environment survey"
	default n
```

## prj.conf
```kconfig
CONFIG_SERIAL=y
CONFIG_GPIO=y
CONFIG_CONSOLE=y
CONFIG_UART_CONSOLE=y
CONFIG_PRINTK=y
CONFIG_STDOUT_CONSOLE=y

CONFIG_BT=y
CONFIG_BT_CENTRAL=y
CONFIG_BT_OBSERVER=y
CONFIG_BT_GATT_CLIENT=y
CONFIG_BT_GATT_AUTO_DISCOVER_CCC=y
CONFIG_BT_GATT_AUTO_UPDATE_MTU=y
CONFIG_BT_MAX_CONN=1

CONFIG_BT_L2CAP_TX_MTU=247
CONFIG_BT_BUF_ACL_RX_SIZE=251
CONFIG_BT_BUF_ACL_TX_SIZE=251

CONFIG_MAIN_STACK_SIZE=4096
CONFIG_SYSTEM_WORKQUEUE_STACK_SIZE=2048
CONFIG_HEAP_MEM_POOL_SIZE=4096

CONFIG_LOG=n
CONFIG_LOG_PRINTK=n

CONFIG_ASSERT=y
```

## network_scan.conf
```kconfig
CONFIG_EMG_NETWORK_SCAN=y

# BLE
CONFIG_BT_OBSERVER=y

# Wi-Fi. El ESP32-S3 ejecuta ambos sondeos de forma secuencial.
CONFIG_WIFI=y
CONFIG_NETWORKING=y
CONFIG_NET_IPV4=y
CONFIG_NET_IPV6=n
CONFIG_NET_MGMT=y
CONFIG_NET_MGMT_EVENT=y
CONFIG_NET_L2_WIFI_MGMT=y
CONFIG_TEST_RANDOM_GENERATOR=y
CONFIG_NET_MGMT_EVENT_QUEUE_SIZE=64
CONFIG_NET_MGMT_EVENT_QUEUE_TIMEOUT=5000
CONFIG_NET_MGMT_EVENT_STACK_SIZE=4096
CONFIG_NET_RX_STACK_SIZE=4096
CONFIG_NET_TX_STACK_SIZE=4096
CONFIG_MAIN_STACK_SIZE=6144
```

## postexperiment.conf
```kconfig
CONFIG_EMG_POSTEXPERIMENT=y
CONFIG_BT_USER_PHY_UPDATE=y
CONFIG_BT_USER_DATA_LEN_UPDATE=y
CONFIG_BT_AUTO_DATA_LEN_UPDATE=y
```

## preexperiment.conf
```kconfig
CONFIG_EMG_PREEXPERIMENT=y
CONFIG_BT_USER_PHY_UPDATE=y
CONFIG_BT_USER_DATA_LEN_UPDATE=y
CONFIG_BT_AUTO_DATA_LEN_UPDATE=y
```

## boards/esp32s3_devkitc_esp32s3_procpu.conf
```kconfig
# ESP32-S3-WROOM-1-N16R8: 16 MB Quad SPI flash and 8 MB Octal SPI PSRAM.
CONFIG_SPIRAM_MODE_OCT=y
CONFIG_ESPTOOLPY_OCT_FLASH=n
CONFIG_ESPTOOLPY_FLASHMODE_DIO=y
CONFIG_ESPTOOLPY_FLASH_SAMPLE_MODE_STR=y
CONFIG_ESPTOOLPY_FLASHSIZE_16MB=y
```

## boards/esp32s3_devkitc_esp32s3_procpu.overlay
```dts
/ {
	zephyr,user {
		sync-gpios = <&gpio0 4 GPIO_ACTIVE_HIGH>;
	};
};
```

## src/main.c
```c
#include <zephyr/bluetooth/bluetooth.h>
#include <zephyr/kernel.h>
#include <zephyr/sys/printk.h>

#include "custom_client.h"
#include "sync_controller.h"

int main(void)
{
	int err;

	printk("Booting central_min\n");

	err = sync_controller_init();
	if (err) {
		printk("Synchronization output init failed: %d\n", err);
		return 0;
	}

	err = bt_enable(NULL);
	if (err) {
		printk("Bluetooth init failed: %d\n", err);
		return 0;
	}

	printk("Bluetooth initialized\n");

	err = custom_client_start();
	if (err) {
		printk("Client start failed: %d\n", err);
		return 0;
	}

	while (true) {
		k_sleep(K_SECONDS(10));
	}
}
```

## src/custom_client.c
```c
#include <errno.h>
#include <stdbool.h>
#include <string.h>

#include <zephyr/bluetooth/bluetooth.h>
#include <zephyr/bluetooth/conn.h>
#include <zephyr/bluetooth/gatt.h>
#include <zephyr/bluetooth/hci.h>
#include <zephyr/bluetooth/uuid.h>
#include <zephyr/kernel.h>
#include <zephyr/sys/printk.h>

#include "custom_client.h"
#include "emg_protocol.h"
#include "experiment_receiver.h"
#include "sync_controller.h"

#define TARGET_NAME "Xiao_GATT_Min"

#define BT_UUID_MIN_SERVICE_VAL \
	BT_UUID_128_ENCODE(0x12345678, 0x1234, 0x5678, 0x1234, 0x56789abcdef0)
#define BT_UUID_MIN_RX_VAL \
	BT_UUID_128_ENCODE(0x12345678, 0x1234, 0x5678, 0x1234, 0x56789abcdef1)
#define BT_UUID_MIN_TX_VAL \
	BT_UUID_128_ENCODE(0x12345678, 0x1234, 0x5678, 0x1234, 0x56789abcdef2)

enum discovery_step {
	DISCOVERY_IDLE,
	DISCOVERY_SERVICE,
	DISCOVERY_RX,
	DISCOVERY_TX,
};

struct scan_match {
	bool matched;
};

static struct bt_conn *current_conn;
static struct bt_gatt_discover_params discover_params;
static struct bt_gatt_subscribe_params subscribe_params;
static K_MUTEX_DEFINE(control_write_mutex);
static K_SEM_DEFINE(control_write_complete, 0, 1);
static uint8_t control_write_att_error;

static enum discovery_step discovery_state;
static uint16_t service_start_handle;
static uint16_t service_end_handle;
static uint16_t rx_handle;
static uint16_t tx_handle;

static struct bt_uuid_128 service_uuid = BT_UUID_INIT_128(BT_UUID_MIN_SERVICE_VAL);
static struct bt_uuid_128 rx_uuid = BT_UUID_INIT_128(BT_UUID_MIN_RX_VAL);
static struct bt_uuid_128 tx_uuid = BT_UUID_INIT_128(BT_UUID_MIN_TX_VAL);

static void att_mtu_updated(struct bt_conn *conn, uint16_t tx, uint16_t rx)
{
	ARG_UNUSED(conn);
	printk("ATT MTU updated: tx=%u rx=%u\n", tx, rx);
}

static struct bt_gatt_cb gatt_callbacks = {
	.att_mtu_updated = att_mtu_updated,
};

static void start_scan(void);
static int discover_service(void);
static int discover_rx_characteristic(void);
static int discover_tx_characteristic(void);
static int subscribe_to_tx(void);

static bool data_cb(struct bt_data *data, void *user_data)
{
	struct scan_match *match = user_data;

	if (data->type != BT_DATA_NAME_COMPLETE) {
		return true;
	}

	if ((data->data_len == strlen(TARGET_NAME)) &&
	    (memcmp(data->data, TARGET_NAME, data->data_len) == 0)) {
		match->matched = true;
		return false;
	}

	return true;
}

static bool advertisement_matches(struct net_buf_simple *ad)
{
	struct scan_match match = {0};

	bt_data_parse(ad, data_cb, &match);
	return match.matched;
}

static void control_write_cb(struct bt_conn *conn, uint8_t err,
			     struct bt_gatt_write_params *params)
{
	ARG_UNUSED(conn);
	ARG_UNUSED(params);

	control_write_att_error = err;
	k_sem_give(&control_write_complete);
}

int custom_client_send_control(uint8_t command)
{
	uint8_t payload[EMG_CONTROL_SIZE];
	struct bt_gatt_write_params params = {0};
	struct bt_conn *conn;
	int err;

	k_mutex_lock(&control_write_mutex, K_FOREVER);
	if ((current_conn == NULL) || (rx_handle == 0U)) {
		k_mutex_unlock(&control_write_mutex);
		return -ENOTCONN;
	}

	conn = bt_conn_ref(current_conn);
	emg_control_encode(payload, command);
	params.func = control_write_cb;
	params.handle = rx_handle;
	params.offset = 0U;
	params.data = payload;
	params.length = sizeof(payload);
	control_write_att_error = 0U;
	k_sem_reset(&control_write_complete);

	err = bt_gatt_write(conn, &params);
	if (err == 0) {
		err = k_sem_take(&control_write_complete, K_SECONDS(2));
		if (err != 0) {
			bt_gatt_cancel(conn, &params);
		} else if (control_write_att_error != 0U) {
			err = -EIO;
		}
	}

	bt_conn_unref(conn);
	k_mutex_unlock(&control_write_mutex);
	return err;
}

static uint8_t notify_cb(struct bt_conn *conn, struct bt_gatt_subscribe_params *params,
			 const void *data, uint16_t length)
{
	ARG_UNUSED(conn);
	ARG_UNUSED(params);

	if (data == NULL) {
		printk("Notification subscription removed\n");
		return BT_GATT_ITER_STOP;
	}

	if (!sync_controller_process_notification(data, length)) {
		experiment_receiver_process(data, length);
	}

	return BT_GATT_ITER_CONTINUE;
}

static void subscribe_cb(struct bt_conn *conn, uint8_t err,
			 struct bt_gatt_subscribe_params *params)
{
	ARG_UNUSED(conn);
	ARG_UNUSED(params);

	if (err) {
		printk("Subscribe failed: 0x%02x\n", err);
		return;
	}

	printk("Subscribed to TX notifications\n");
	sync_controller_session_ready();
}

static uint8_t discover_cb(struct bt_conn *conn, const struct bt_gatt_attr *attr,
			   struct bt_gatt_discover_params *params)
{
	int err;

	if (attr == NULL) {
		printk("Discovery failed in step %d\n", discovery_state);
		memset(params, 0, sizeof(*params));
		return BT_GATT_ITER_STOP;
	}

	if (discovery_state == DISCOVERY_SERVICE) {
		const struct bt_gatt_service_val *service = attr->user_data;

		service_start_handle = attr->handle;
		service_end_handle = service->end_handle;
		printk("Service found: start=0x%04x end=0x%04x\n",
		       service_start_handle, service_end_handle);

		memset(params, 0, sizeof(*params));
		err = discover_rx_characteristic();
		if (err) {
			printk("RX characteristic discovery start failed: %d\n", err);
		}
		return BT_GATT_ITER_STOP;
	}

	if ((discovery_state == DISCOVERY_RX) || (discovery_state == DISCOVERY_TX)) {
		const struct bt_gatt_chrc *chrc = attr->user_data;

		if (discovery_state == DISCOVERY_RX) {
			rx_handle = chrc->value_handle;
			printk("RX characteristic found: handle=0x%04x\n", rx_handle);

			memset(params, 0, sizeof(*params));
			err = discover_tx_characteristic();
			if (err) {
				printk("TX characteristic discovery start failed: %d\n", err);
			}
			return BT_GATT_ITER_STOP;
		}

		tx_handle = chrc->value_handle;
		printk("TX characteristic found: handle=0x%04x\n", tx_handle);

		memset(params, 0, sizeof(*params));
		err = subscribe_to_tx();
		if (err) {
			printk("Subscribe request failed: %d\n", err);
		}
		return BT_GATT_ITER_STOP;
	}

	return BT_GATT_ITER_STOP;
}

static int discover_service(void)
{
	discovery_state = DISCOVERY_SERVICE;

	discover_params.func = discover_cb;
	discover_params.start_handle = BT_ATT_FIRST_ATTRIBUTE_HANDLE;
	discover_params.end_handle = BT_ATT_LAST_ATTRIBUTE_HANDLE;
	discover_params.type = BT_GATT_DISCOVER_PRIMARY;
	discover_params.uuid = &service_uuid.uuid;

	return bt_gatt_discover(current_conn, &discover_params);
}

static int discover_rx_characteristic(void)
{
	discovery_state = DISCOVERY_RX;

	discover_params.func = discover_cb;
	discover_params.start_handle = service_start_handle + 1U;
	discover_params.end_handle = service_end_handle;
	discover_params.type = BT_GATT_DISCOVER_CHARACTERISTIC;
	discover_params.uuid = &rx_uuid.uuid;

	return bt_gatt_discover(current_conn, &discover_params);
}

static int discover_tx_characteristic(void)
{
	discovery_state = DISCOVERY_TX;

	discover_params.func = discover_cb;
	discover_params.start_handle = service_start_handle + 1U;
	discover_params.end_handle = service_end_handle;
	discover_params.type = BT_GATT_DISCOVER_CHARACTERISTIC;
	discover_params.uuid = &tx_uuid.uuid;

	return bt_gatt_discover(current_conn, &discover_params);
}

static int subscribe_to_tx(void)
{
	memset(&subscribe_params, 0, sizeof(subscribe_params));

	subscribe_params.notify = notify_cb;
	subscribe_params.subscribe = subscribe_cb;
	subscribe_params.value = BT_GATT_CCC_NOTIFY;
	subscribe_params.value_handle = tx_handle;
	subscribe_params.ccc_handle = BT_GATT_AUTO_DISCOVER_CCC_HANDLE;
	subscribe_params.end_handle = service_end_handle;
	subscribe_params.disc_params = &discover_params;

	return bt_gatt_subscribe(current_conn, &subscribe_params);
}

static void reset_client_state(void)
{
	discovery_state = DISCOVERY_IDLE;
	service_start_handle = 0U;
	service_end_handle = 0U;
	rx_handle = 0U;
	tx_handle = 0U;
	memset(&discover_params, 0, sizeof(discover_params));
	memset(&subscribe_params, 0, sizeof(subscribe_params));
}

static void connected(struct bt_conn *conn, uint8_t err)
{
	char addr[BT_ADDR_LE_STR_LEN];
	int discover_err;

	bt_addr_le_to_str(bt_conn_get_dst(conn), addr, sizeof(addr));

	if (err) {
		printk("Connection failed to %s: %u\n", addr, err);
		if (current_conn != NULL) {
			bt_conn_unref(current_conn);
			current_conn = NULL;
		}
		start_scan();
		return;
	}

	printk("Connected: %s\n", addr);
	reset_client_state();
	experiment_receiver_reset();

	discover_err = discover_service();
	if (discover_err) {
		printk("Service discovery start failed: %d\n", discover_err);
	}
}

static void disconnected(struct bt_conn *conn, uint8_t reason)
{
	char addr[BT_ADDR_LE_STR_LEN];

	bt_addr_le_to_str(bt_conn_get_dst(conn), addr, sizeof(addr));
	printk("Disconnected: %s reason=0x%02x\n", addr, reason);
	sync_controller_disconnected();

	if (current_conn == conn) {
		bt_conn_unref(current_conn);
		current_conn = NULL;
	}

	reset_client_state();
	start_scan();
}

static void le_param_updated(struct bt_conn *conn, uint16_t interval,
			     uint16_t latency, uint16_t timeout)
{
	ARG_UNUSED(conn);
	printk("BLE parameter update: interval=%u us latency=%u timeout=%u ms\n",
	       BT_CONN_INTERVAL_TO_US(interval), latency, timeout * 10U);
}

#if defined(CONFIG_BT_USER_PHY_UPDATE)
static void le_phy_updated(struct bt_conn *conn,
			   struct bt_conn_le_phy_info *info)
{
	ARG_UNUSED(conn);
	printk("BLE PHY update: tx=%u rx=%u\n",
	       info->tx_phy, info->rx_phy);
}
#endif

#if defined(CONFIG_BT_USER_DATA_LEN_UPDATE)
static void le_data_len_updated(struct bt_conn *conn,
				struct bt_conn_le_data_len_info *info)
{
	ARG_UNUSED(conn);
	printk("BLE data length update: tx=%uB/%uus rx=%uB/%uus\n",
	       info->tx_max_len, info->tx_max_time,
	       info->rx_max_len, info->rx_max_time);
}
#endif

BT_CONN_CB_DEFINE(conn_callbacks) = {
	.connected = connected,
	.disconnected = disconnected,
	.le_param_updated = le_param_updated,
#if defined(CONFIG_BT_USER_PHY_UPDATE)
	.le_phy_updated = le_phy_updated,
#endif
#if defined(CONFIG_BT_USER_DATA_LEN_UPDATE)
	.le_data_len_updated = le_data_len_updated,
#endif
};

static void device_found(const bt_addr_le_t *addr, int8_t rssi, uint8_t type,
			 struct net_buf_simple *ad)
{
	char addr_str[BT_ADDR_LE_STR_LEN];
	int err;

	if (current_conn != NULL) {
		return;
	}

	if ((type != BT_GAP_ADV_TYPE_ADV_IND) &&
	    (type != BT_GAP_ADV_TYPE_EXT_ADV) &&
	    (type != BT_GAP_ADV_TYPE_SCAN_RSP)) {
		return;
	}

	if (!advertisement_matches(ad)) {
		return;
	}

	bt_addr_le_to_str(addr, addr_str, sizeof(addr_str));
	printk("Found target %s RSSI=%d\n", addr_str, rssi);

	err = bt_le_scan_stop();
	if ((err != 0) && (err != -EALREADY)) {
		printk("Scan stop failed: %d\n", err);
	}

	err = bt_conn_le_create(addr, BT_CONN_LE_CREATE_CONN,
				BT_LE_CONN_PARAM_DEFAULT, &current_conn);
	if (err) {
		printk("Create connection failed: %d\n", err);
		current_conn = NULL;
		start_scan();
		return;
	}

	printk("Connecting...\n");
}

static void start_scan(void)
{
	int err;

	if (current_conn != NULL) {
		return;
	}

	err = bt_le_scan_start(BT_LE_SCAN_ACTIVE, device_found);
	if (err == -EALREADY) {
		return;
	}

	if (err) {
		printk("Scan start failed: %d\n", err);
		return;
	}

	printk("Scanning for %s\n", TARGET_NAME);
}

int custom_client_start(void)
{
	reset_client_state();
	bt_gatt_cb_register(&gatt_callbacks);
	start_scan();
	return 0;
}

int custom_client_print_link_state(void)
{
	struct bt_conn_info info;
	struct bt_conn *conn;
	int err;

	if (current_conn == NULL) {
		return -ENOTCONN;
	}

	conn = bt_conn_ref(current_conn);
	err = bt_conn_get_info(conn, &info);
	if (err) {
		bt_conn_unref(conn);
		return err;
	}

	printk("L,interval_us,%u\n", info.le.interval_us);
	printk("L,latency,%u\n", info.le.latency);
	printk("L,timeout_ms,%u\n", info.le.timeout * 10U);
#if defined(CONFIG_BT_USER_PHY_UPDATE)
	if (info.le.phy != NULL) {
		printk("L,phy_tx,%u\n", info.le.phy->tx_phy);
		printk("L,phy_rx,%u\n", info.le.phy->rx_phy);
	}
#endif
#if defined(CONFIG_BT_USER_DATA_LEN_UPDATE)
	if (info.le.data_len != NULL) {
		printk("L,data_len_tx_bytes,%u\n",
		       info.le.data_len->tx_max_len);
		printk("L,data_len_rx_bytes,%u\n",
		       info.le.data_len->rx_max_len);
		printk("L,data_time_tx_us,%u\n",
		       info.le.data_len->tx_max_time);
		printk("L,data_time_rx_us,%u\n",
		       info.le.data_len->rx_max_time);
	}
#endif

	bt_conn_unref(conn);
	return 0;
}
```

## src/custom_client.h
```c
#ifndef CUSTOM_CLIENT_H_
#define CUSTOM_CLIENT_H_

#include <stdint.h>

int custom_client_start(void);
int custom_client_send_control(uint8_t command);
int custom_client_print_link_state(void);

#endif /* CUSTOM_CLIENT_H_ */
```

## src/experiment_receiver.c
```c
#include <stdbool.h>
#include <stdint.h>
#include <string.h>

#include <zephyr/kernel.h>
#include <zephyr/sys/printk.h>

#include "emg_protocol.h"
#include "experiment_receiver.h"

#define EXPERIMENT_MAX_RECORDS 50000U

struct experiment_record {
	uint64_t acquisition_time_us;
	uint64_t tx_time_us;
	uint64_t rx_time_us;
	uint32_t packet_id;
	uint16_t payload_bytes;
	uint8_t config_id;
	uint8_t fragments;
};

BUILD_ASSERT(sizeof(struct experiment_record) == 32U);

/*
 * The saturation preexperiment can exceed 20000 packets. Keep 50000 compact
 * records in external PSRAM so the radio measurement remains free of UART
 * output and all data can be dumped after the final synchronization.
 */
static struct experiment_record records[EXPERIMENT_MAX_RECORDS]
	__attribute__((section(".ext_ram.bss.experiment_records")));
static struct emg_fragment_header current_header;
static uint32_t last_completed_packet_id;
static uint8_t last_completed_config_id;
static uint32_t record_count;
static uint32_t incomplete_count;
static uint32_t lost_packet_count;
static uint32_t invalid_fragment_count;
static uint32_t inconsistent_header_count;
static uint32_t duplicate_fragment_count;
static uint32_t overflow_count;
static uint16_t received_bytes;
static uint8_t received_fragments;
static bool packet_active;
static bool have_last_completed;

static uint8_t expected_fragment_mask(uint8_t fragment_count)
{
	return (uint8_t)((1U << fragment_count) - 1U);
}

static void report_incomplete(void)
{
	if (packet_active) {
		incomplete_count++;
	}
}

static void begin_packet(const struct emg_fragment_header *header)
{
	if (have_last_completed &&
	    (header->config_id == last_completed_config_id) &&
	    (header->packet_id > (last_completed_packet_id + 1U))) {
		lost_packet_count +=
			header->packet_id - (last_completed_packet_id + 1U);
	}

	current_header = *header;
	received_bytes = 0U;
	received_fragments = 0U;
	packet_active = true;
}

void experiment_receiver_reset(void)
{
	memset(&current_header, 0, sizeof(current_header));
	received_bytes = 0U;
	received_fragments = 0U;
	packet_active = false;
	have_last_completed = false;
	last_completed_config_id = 0U;
	record_count = 0U;
	incomplete_count = 0U;
	lost_packet_count = 0U;
	invalid_fragment_count = 0U;
	inconsistent_header_count = 0U;
	duplicate_fragment_count = 0U;
	overflow_count = 0U;
}

void experiment_receiver_process(const uint8_t *data, uint16_t len)
{
	struct emg_fragment_header header;
	uint8_t fragment_bit;

	if (emg_header_decode(&header, data, len) != 0) {
		invalid_fragment_count++;
		return;
	}

	if (!packet_active || (header.packet_id != current_header.packet_id)) {
		report_incomplete();
		begin_packet(&header);
	}

	if ((header.config_id != current_header.config_id) ||
	    (header.acquisition_time_us != current_header.acquisition_time_us) ||
	    (header.tx_time_us != current_header.tx_time_us) ||
	    (header.packet_payload_len != current_header.packet_payload_len) ||
	    (header.fragment_count != current_header.fragment_count)) {
		inconsistent_header_count++;
		packet_active = false;
		return;
	}

	fragment_bit = (uint8_t)(1U << header.fragment_index);
	if ((received_fragments & fragment_bit) != 0U) {
		duplicate_fragment_count++;
		return;
	}

	received_bytes += header.fragment_payload_len;
	received_fragments |= fragment_bit;

	if ((received_bytes == current_header.packet_payload_len) &&
	    (received_fragments == expected_fragment_mask(current_header.fragment_count))) {
		uint64_t rx_time_us = k_ticks_to_us_floor64(k_uptime_ticks());

		if (record_count < ARRAY_SIZE(records)) {
			struct experiment_record *record = &records[record_count++];

			record->acquisition_time_us =
				current_header.acquisition_time_us;
			record->tx_time_us = current_header.tx_time_us;
			record->rx_time_us = rx_time_us;
			record->packet_id = current_header.packet_id;
			record->payload_bytes = current_header.packet_payload_len;
			record->config_id = current_header.config_id;
			record->fragments = current_header.fragment_count;
		} else {
			overflow_count++;
		}

		last_completed_packet_id = current_header.packet_id;
		last_completed_config_id = current_header.config_id;
		have_last_completed = true;
		packet_active = false;
	}
}

void experiment_receiver_dump(void)
{
	printk("CSV,event,config_id,packet_id,acquisition_time_us,tx_time_us,rx_time_us,payload_bytes,fragments\n");

	for (uint32_t index = 0U; index < record_count; index++) {
		const struct experiment_record *record = &records[index];

		printk("D,0x%02x,%u,%llu,%llu,%llu,%u,%u\n",
		       record->config_id, record->packet_id,
		       record->acquisition_time_us,
		       record->tx_time_us, record->rx_time_us,
		       record->payload_bytes, record->fragments);
	}

	printk("R,records,%u\n", record_count);
	printk("R,incomplete_packets,%u\n", incomplete_count);
	printk("R,lost_packets,%u\n", lost_packet_count);
	printk("R,invalid_fragments,%u\n", invalid_fragment_count);
	printk("R,inconsistent_headers,%u\n", inconsistent_header_count);
	printk("R,duplicate_fragments,%u\n", duplicate_fragment_count);
	printk("R,buffer_overflow,%u\n", overflow_count);
}
```

## src/experiment_receiver.h
```c
#ifndef EXPERIMENT_RECEIVER_H_
#define EXPERIMENT_RECEIVER_H_

#include <stdint.h>

void experiment_receiver_reset(void);
void experiment_receiver_process(const uint8_t *data, uint16_t len);
void experiment_receiver_dump(void);

#endif /* EXPERIMENT_RECEIVER_H_ */
```

## src/network_scan.c
```c
#include <errno.h>
#include <stdbool.h>
#include <stdint.h>
#include <string.h>

#include <zephyr/bluetooth/addr.h>
#include <zephyr/bluetooth/bluetooth.h>
#include <zephyr/bluetooth/gap.h>
#include <zephyr/bluetooth/hci_types.h>
#include <zephyr/kernel.h>
#include <zephyr/net/net_if.h>
#include <zephyr/net/net_mgmt.h>
#include <zephyr/net/wifi.h>
#include <zephyr/net/wifi_mgmt.h>
#include <zephyr/net_buf.h>
#include <zephyr/sys/printk.h>

#define BLE_SURVEY_DURATION_SECONDS 60U
#define WIFI_SURVEY_DURATION_SECONDS 60U
#define SURVEY_START_DELAY_SECONDS 5U
#define BLE_SURVEY_MAX_DEVICES 128U
#define WIFI_SURVEY_MAX_NETWORKS 64U
#define SURVEY_NAME_MAX 63U
#define WIFI_SCAN_TIMEOUT_SECONDS 20U
#define WIFI_SCAN_GAP_MS 1000U

struct observed_device {
	bt_addr_le_t address;
	char name[SURVEY_NAME_MAX + 1U];
	uint32_t observations;
	int32_t rssi_sum;
	int8_t rssi_min;
	int8_t rssi_max;
	uint32_t first_seen_ms;
	uint32_t last_seen_ms;
	uint32_t advertising_type_mask;
	bool name_complete;
};

struct parsed_name {
	char value[SURVEY_NAME_MAX + 1U];
	bool present;
	bool complete;
};

struct observed_wifi {
	uint8_t bssid[WIFI_MAC_ADDR_LEN];
	char ssid[WIFI_SSID_MAX_LEN + 1U];
	uint32_t observations;
	int32_t rssi_sum;
	int8_t rssi_min;
	int8_t rssi_max;
	uint32_t first_seen_ms;
	uint32_t last_seen_ms;
	uint8_t band;
	uint8_t channel;
	enum wifi_security_type security;
};

static struct observed_device devices[BLE_SURVEY_MAX_DEVICES];
static size_t device_count;
static uint32_t untracked_reports;
static int64_t scan_start_ms;
static struct observed_wifi wifi_networks[WIFI_SURVEY_MAX_NETWORKS];
static size_t wifi_network_count;
static uint32_t wifi_untracked_results;
static uint32_t wifi_scan_count;
static int64_t wifi_scan_start_ms;
static struct net_mgmt_event_callback wifi_callback;
static K_SEM_DEFINE(wifi_scan_done, 0, 1);

static const struct bt_le_scan_param scan_parameters = {
	.type = BT_LE_SCAN_TYPE_ACTIVE,
	.options = BT_LE_SCAN_OPT_NONE,
	.interval = BT_GAP_SCAN_FAST_INTERVAL,
	.window = BT_GAP_SCAN_FAST_WINDOW,
	.timeout = 0U,
};

static const struct wifi_scan_params wifi_scan_parameters = {
	.scan_type = WIFI_SCAN_TYPE_ACTIVE,
	.bands = BIT(WIFI_FREQ_BAND_2_4_GHZ),
};

static const char *address_type_name(uint8_t type)
{
	switch (type) {
	case BT_ADDR_LE_PUBLIC:
		return "public";
	case BT_ADDR_LE_RANDOM:
		return "random";
	case BT_ADDR_LE_PUBLIC_ID:
		return "public_identity";
	case BT_ADDR_LE_RANDOM_ID:
		return "random_identity";
	default:
		return "unknown";
	}
}

static bool parse_name_cb(struct bt_data *data, void *user_data)
{
	struct parsed_name *parsed = user_data;
	size_t length;

	if ((data->type != BT_DATA_NAME_COMPLETE) &&
	    (data->type != BT_DATA_NAME_SHORTENED)) {
		return true;
	}

	if (parsed->complete && (data->type == BT_DATA_NAME_SHORTENED)) {
		return true;
	}

	length = MIN((size_t)data->data_len, (size_t)SURVEY_NAME_MAX);
	for (size_t index = 0U; index < length; index++) {
		uint8_t character = data->data[index];

		/* Mantiene cada registro en una sola fila CSV sin depender de UTF-8. */
		if ((character < 0x20U) || (character > 0x7eU)) {
			parsed->value[index] = '?';
		} else if (character == ',') {
			parsed->value[index] = ';';
		} else {
			parsed->value[index] = (char)character;
		}
	}
	parsed->value[length] = '\0';
	parsed->present = true;
	parsed->complete = data->type == BT_DATA_NAME_COMPLETE;
	return !parsed->complete;
}

static void sanitize_bytes(char *destination, size_t destination_size,
			   const uint8_t *source, size_t source_size)
{
	size_t length = MIN(source_size, destination_size - 1U);

	for (size_t index = 0U; index < length; index++) {
		uint8_t character = source[index];

		if ((character < 0x20U) || (character > 0x7eU)) {
			destination[index] = '?';
		} else if (character == ',') {
			destination[index] = ';';
		} else {
			destination[index] = (char)character;
		}
	}
	destination[length] = '\0';
}

static struct observed_device *find_device(const bt_addr_le_t *address)
{
	for (size_t index = 0U; index < device_count; index++) {
		if (bt_addr_le_cmp(&devices[index].address, address) == 0) {
			return &devices[index];
		}
	}

	return NULL;
}

static struct observed_device *create_device(const bt_addr_le_t *address,
					      int8_t rssi,
					      uint32_t elapsed_ms)
{
	struct observed_device *device;

	if (device_count >= ARRAY_SIZE(devices)) {
		untracked_reports++;
		return NULL;
	}

	device = &devices[device_count++];
	memset(device, 0, sizeof(*device));
	bt_addr_le_copy(&device->address, address);
	device->rssi_min = rssi;
	device->rssi_max = rssi;
	device->first_seen_ms = elapsed_ms;
	device->last_seen_ms = elapsed_ms;
	return device;
}

static void device_found(const bt_addr_le_t *address, int8_t rssi, uint8_t type,
			 struct net_buf_simple *advertising_data)
{
	struct parsed_name parsed = {0};
	struct observed_device *device;
	uint32_t elapsed_ms;

	if (rssi == BT_HCI_LE_RSSI_NOT_AVAILABLE) {
		return;
	}

	elapsed_ms = (uint32_t)(k_uptime_get() - scan_start_ms);
	device = find_device(address);
	if (device == NULL) {
		device = create_device(address, rssi, elapsed_ms);
		if (device == NULL) {
			return;
		}
	}

	bt_data_parse(advertising_data, parse_name_cb, &parsed);
	if (parsed.present && (!device->name_complete || parsed.complete)) {
		memcpy(device->name, parsed.value, sizeof(device->name));
		device->name_complete = parsed.complete;
	}

	device->observations++;
	device->rssi_sum += rssi;
	device->rssi_min = MIN(device->rssi_min, rssi);
	device->rssi_max = MAX(device->rssi_max, rssi);
	device->last_seen_ms = elapsed_ms;
	if (type < 32U) {
		device->advertising_type_mask |= BIT(type);
	}
}

static void print_mean_rssi(const struct observed_device *device)
{
	int32_t mean_x100 =
		(device->rssi_sum * 100) / (int32_t)device->observations;
	uint32_t magnitude =
		mean_x100 < 0 ? (uint32_t)(-mean_x100) : (uint32_t)mean_x100;

	if (mean_x100 < 0) {
		printk("-%u.%02u", magnitude / 100U, magnitude % 100U);
	} else {
		printk("%u.%02u", magnitude / 100U, magnitude % 100U);
	}
}

static size_t strongest_unprinted(const bool *printed)
{
	size_t strongest = ARRAY_SIZE(devices);

	for (size_t index = 0U; index < device_count; index++) {
		if (printed[index]) {
			continue;
		}
		if ((strongest == ARRAY_SIZE(devices)) ||
		    (devices[index].rssi_max > devices[strongest].rssi_max)) {
			strongest = index;
		}
	}

	return strongest;
}

static void print_results(void)
{
	bool printed[BLE_SURVEY_MAX_DEVICES] = {0};

	printk("CSV_BLE,event,address,address_type,name,observations,"
	       "rssi_min_dbm,rssi_mean_dbm,rssi_max_dbm,"
	       "first_seen_ms,last_seen_ms,advertising_type_mask\n");

	for (size_t row = 0U; row < device_count; row++) {
		size_t index = strongest_unprinted(printed);
		struct observed_device *device;
		char address[BT_ADDR_STR_LEN];

		if (index == ARRAY_SIZE(devices)) {
			break;
		}

		printed[index] = true;
		device = &devices[index];
		bt_addr_to_str(&device->address.a, address, sizeof(address));

		printk("BLE,%s,%s,%s,%u,%d,",
		       address,
		       address_type_name(device->address.type),
		       device->name[0] != '\0' ? device->name : "<unnamed>",
		       device->observations,
		       device->rssi_min);
		print_mean_rssi(device);
		printk(",%d,%u,%u,0x%08x\n",
		       device->rssi_max,
		       device->first_seen_ms,
		       device->last_seen_ms,
		       device->advertising_type_mask);
	}

	printk("SUMMARY_BLE,unique_devices,%u\n", (uint32_t)device_count);
	printk("SUMMARY_BLE,untracked_reports,%u\n", untracked_reports);
}

static struct observed_wifi *find_wifi_network(const uint8_t *bssid)
{
	for (size_t index = 0U; index < wifi_network_count; index++) {
		if (memcmp(wifi_networks[index].bssid, bssid,
			   WIFI_MAC_ADDR_LEN) == 0) {
			return &wifi_networks[index];
		}
	}

	return NULL;
}

static void process_wifi_result(const struct wifi_scan_result *result)
{
	struct observed_wifi *network;
	uint32_t elapsed_ms =
		(uint32_t)(k_uptime_get() - wifi_scan_start_ms);

	network = find_wifi_network(result->mac);
	if (network == NULL) {
		if (wifi_network_count >= ARRAY_SIZE(wifi_networks)) {
			wifi_untracked_results++;
			return;
		}

		network = &wifi_networks[wifi_network_count++];
		memset(network, 0, sizeof(*network));
		memcpy(network->bssid, result->mac, WIFI_MAC_ADDR_LEN);
		network->rssi_min = result->rssi;
		network->rssi_max = result->rssi;
		network->first_seen_ms = elapsed_ms;
	}

	sanitize_bytes(network->ssid, sizeof(network->ssid),
		       result->ssid, result->ssid_length);
	network->observations++;
	network->rssi_sum += result->rssi;
	network->rssi_min = MIN(network->rssi_min, result->rssi);
	network->rssi_max = MAX(network->rssi_max, result->rssi);
	network->last_seen_ms = elapsed_ms;
	network->band = result->band;
	network->channel = result->channel;
	network->security = result->security;
}

static void wifi_event_handler(struct net_mgmt_event_callback *callback,
			       uint64_t event, struct net_if *interface)
{
	ARG_UNUSED(interface);

	if (event == NET_EVENT_WIFI_SCAN_RESULT) {
		process_wifi_result(
			(const struct wifi_scan_result *)callback->info);
	} else if (event == NET_EVENT_WIFI_SCAN_DONE) {
		k_sem_give(&wifi_scan_done);
	}
}

static int run_wifi_survey(void)
{
	struct net_if *interface = net_if_get_default();
	int64_t deadline;

	if (interface == NULL) {
		return -ENODEV;
	}

	net_mgmt_init_event_callback(
		&wifi_callback, wifi_event_handler,
		NET_EVENT_WIFI_SCAN_RESULT | NET_EVENT_WIFI_SCAN_DONE);
	net_mgmt_add_event_callback(&wifi_callback);

	wifi_scan_start_ms = k_uptime_get();
	deadline = wifi_scan_start_ms +
		   ((int64_t)WIFI_SURVEY_DURATION_SECONDS * MSEC_PER_SEC);

	while (k_uptime_get() < deadline) {
		int err;

		k_sem_reset(&wifi_scan_done);
		err = net_mgmt(NET_REQUEST_WIFI_SCAN, interface,
			       (void *)&wifi_scan_parameters,
			       sizeof(wifi_scan_parameters));
		if (err != 0) {
			net_mgmt_del_event_callback(&wifi_callback);
			return err;
		}

		err = k_sem_take(&wifi_scan_done,
				 K_SECONDS(WIFI_SCAN_TIMEOUT_SECONDS));
		if (err != 0) {
			net_mgmt_del_event_callback(&wifi_callback);
			return err;
		}

		wifi_scan_count++;
		if (k_uptime_get() < deadline) {
			k_sleep(K_MSEC(WIFI_SCAN_GAP_MS));
		}
	}

	net_mgmt_del_event_callback(&wifi_callback);
	return 0;
}

static size_t strongest_wifi_unprinted(const bool *printed)
{
	size_t strongest = ARRAY_SIZE(wifi_networks);

	for (size_t index = 0U; index < wifi_network_count; index++) {
		if (printed[index]) {
			continue;
		}
		if ((strongest == ARRAY_SIZE(wifi_networks)) ||
		    (wifi_networks[index].rssi_max >
		     wifi_networks[strongest].rssi_max)) {
			strongest = index;
		}
	}

	return strongest;
}

static void print_wifi_mean_rssi(const struct observed_wifi *network)
{
	int32_t mean_x100 =
		(network->rssi_sum * 100) / (int32_t)network->observations;
	uint32_t magnitude =
		mean_x100 < 0 ? (uint32_t)(-mean_x100) : (uint32_t)mean_x100;

	printk("%s%u.%02u",
	       mean_x100 < 0 ? "-" : "",
	       magnitude / 100U,
	       magnitude % 100U);
}

static void print_wifi_results(void)
{
	bool printed[WIFI_SURVEY_MAX_NETWORKS] = {0};

	printk("CSV_WIFI,event,bssid,ssid,band,channel,security,observations,"
	       "rssi_min_dbm,rssi_mean_dbm,rssi_max_dbm,"
	       "first_seen_ms,last_seen_ms\n");

	for (size_t row = 0U; row < wifi_network_count; row++) {
		size_t index = strongest_wifi_unprinted(printed);
		struct observed_wifi *network;

		if (index == ARRAY_SIZE(wifi_networks)) {
			break;
		}

		printed[index] = true;
		network = &wifi_networks[index];
		printk("WIFI,%02x:%02x:%02x:%02x:%02x:%02x,%s,%s,%u,%s,%u,%d,",
		       network->bssid[0], network->bssid[1],
		       network->bssid[2], network->bssid[3],
		       network->bssid[4], network->bssid[5],
		       network->ssid[0] != '\0' ? network->ssid : "<hidden>",
		       wifi_band_txt(network->band),
		       network->channel,
		       wifi_security_txt(network->security),
		       network->observations,
		       network->rssi_min);
		print_wifi_mean_rssi(network);
		printk(",%d,%u,%u\n",
		       network->rssi_max,
		       network->first_seen_ms,
		       network->last_seen_ms);
	}

	printk("SUMMARY_WIFI,unique_networks,%u\n",
	       (uint32_t)wifi_network_count);
	printk("SUMMARY_WIFI,completed_scans,%u\n", wifi_scan_count);
	printk("SUMMARY_WIFI,untracked_results,%u\n",
	       wifi_untracked_results);
}

int main(void)
{
	int err;

	printk("Booting central BLE and Wi-Fi environment survey\n");
	printk("PROFILE,radio_environment_scan,1\n");
	printk("SETTING,ble_duration_s,%u\n", BLE_SURVEY_DURATION_SECONDS);
	printk("SETTING,wifi_duration_s,%u\n", WIFI_SURVEY_DURATION_SECONDS);
	printk("SETTING,start_delay_s,%u\n", SURVEY_START_DELAY_SECONDS);
	printk("SETTING,scan_type,active\n");
	printk("SETTING,scan_interval_units,%u\n", scan_parameters.interval);
	printk("SETTING,scan_window_units,%u\n", scan_parameters.window);
	printk("SETTING,ble_scan_interval_ms,%u\n",
	       (scan_parameters.interval * 625U) / 1000U);
	printk("SETTING,ble_scan_window_ms,%u\n",
	       (scan_parameters.window * 625U) / 1000U);
	printk("SETTING,duplicate_filter,disabled\n");
	printk("SETTING,wifi_scan_type,active\n");
	printk("SETTING,wifi_band,2.4GHz\n");
	printk("SETTING,ble_max_unique_devices,%u\n",
	       BLE_SURVEY_MAX_DEVICES);
	printk("SETTING,wifi_max_unique_networks,%u\n",
	       WIFI_SURVEY_MAX_NETWORKS);

	err = bt_enable(NULL);
	if (err != 0) {
		printk("ERROR,bluetooth_init,%d\n", err);
		printk("Session complete\n");
		return 0;
	}

	printk("Bluetooth initialized\n");
	printk("BLE survey starts in %u seconds\n",
	       SURVEY_START_DELAY_SECONDS);
	k_sleep(K_SECONDS(SURVEY_START_DELAY_SECONDS));

	scan_start_ms = k_uptime_get();
	err = bt_le_scan_start(&scan_parameters, device_found);
	if (err != 0) {
		printk("ERROR,scan_start,%d\n", err);
		printk("Session complete\n");
		return 0;
	}

	printk("BLE survey started\n");
	k_sleep(K_SECONDS(BLE_SURVEY_DURATION_SECONDS));

	err = bt_le_scan_stop();
	if (err != 0) {
		printk("ERROR,scan_stop,%d\n", err);
	}

	printk("BLE survey stopped\n");
	err = bt_disable();
	if (err != 0) {
		printk("WARNING,bluetooth_disable,%d\n", err);
	}

	printk("Wi-Fi survey started\n");
	err = run_wifi_survey();
	if (err != 0) {
		printk("ERROR,wifi_scan,%d\n", err);
	} else {
		printk("Wi-Fi survey stopped\n");
	}

	print_results();
	print_wifi_results();
	printk("Session complete\n");
	return 0;
}
```

## src/sync_controller.c
```c
#include <errno.h>
#include <stdbool.h>
#include <stdint.h>
#include <string.h>

#include <zephyr/drivers/gpio.h>
#include <zephyr/kernel.h>
#include <zephyr/sys/atomic.h>
#include <zephyr/sys/printk.h>

#include "custom_client.h"
#include "emg_protocol.h"
#include "experiment_receiver.h"
#include "sync_controller.h"

#define SYNC_NODE DT_PATH(zephyr_user)
#if defined(CONFIG_EMG_PREEXPERIMENT)
#define EXPERIMENT_DURATION_MS (EMG_PREEXPERIMENT_TOTAL_SECONDS * 1000U)
#define LINK_SETTLE_SECONDS 35U
#elif defined(CONFIG_EMG_POSTEXPERIMENT)
#define EXPERIMENT_DURATION_MS \
	(EMG_POSTEXPERIMENT_DATA_MS + EMG_POSTEXPERIMENT_GUARD_MS)
#define LINK_SETTLE_SECONDS 5U
#else
#define EXPERIMENT_DURATION_MS 60000U
#endif
#define SYNC_COMMAND_SETTLE_MS 250U
#define SYNC_REPORT_TIMEOUT_MS 5000U
#define SYNC_PULSE_PERIOD_MS 100U
#define SYNC_PULSE_WIDTH_MS 10U

BUILD_ASSERT(DT_NODE_HAS_STATUS(SYNC_NODE, okay),
	     "The sync-signal devicetree alias is required");

static const struct gpio_dt_spec sync_gpio =
	GPIO_DT_SPEC_GET(SYNC_NODE, sync_gpios);
static uint64_t central_pulse_time_us[EMG_SYNC_RECORD_COUNT];
static uint64_t peripheral_pulse_time_us[EMG_SYNC_RECORD_COUNT];
static struct emg_experiment_stats
	experiment_stats[EMG_EXPERIMENT_STATS_MAX];
static uint8_t experiment_stats_count;
static uint32_t received_sync_mask;
static atomic_t results_scheduled;
static atomic_t session_generation;
static K_SEM_DEFINE(session_ready_sem, 0, 1);
static K_SEM_DEFINE(results_ready_sem, 0, 1);

static uint64_t local_time_us(void)
{
	return k_ticks_to_us_floor64(k_uptime_ticks());
}

static bool session_is_current(atomic_val_t generation)
{
	return atomic_get(&session_generation) == generation;
}

static void schedule_results_dump(void)
{
	if (atomic_cas(&results_scheduled, 0, 1)) {
		k_sem_give(&results_ready_sem);
	}
}

static bool sleep_checked(uint32_t duration_ms, atomic_val_t generation)
{
	uint32_t elapsed_ms = 0U;

	while (elapsed_ms < duration_ms) {
		const uint32_t interval_ms = MIN(100U, duration_ms - elapsed_ms);

		k_sleep(K_MSEC(interval_ms));
		elapsed_ms += interval_ms;
		if (!session_is_current(generation)) {
			return false;
		}
	}

	return true;
}

static int send_control_checked(uint8_t command, atomic_val_t generation)
{
	int err;

	if (!session_is_current(generation)) {
		return -ENOTCONN;
	}

	err = custom_client_send_control(command);
	if (err) {
		printk("Control command %u failed: %d\n", command, err);
	}
	return err;
}

static bool generate_pulse_group(uint8_t group, atomic_val_t generation)
{
	const uint16_t first_id = group * EMG_SYNC_PULSES_PER_GROUP;

	for (uint8_t index = 0U; index < EMG_SYNC_PULSES_PER_GROUP; index++) {
		const uint16_t pulse_id = first_id + index;

		if (!session_is_current(generation)) {
			gpio_pin_set_dt(&sync_gpio, 0);
			return false;
		}

		gpio_pin_set_dt(&sync_gpio, 1);
		central_pulse_time_us[pulse_id] = local_time_us();
		k_sleep(K_MSEC(SYNC_PULSE_WIDTH_MS));
		gpio_pin_set_dt(&sync_gpio, 0);

		if (!sleep_checked(SYNC_PULSE_PERIOD_MS - SYNC_PULSE_WIDTH_MS,
				   generation)) {
			return false;
		}
	}

	printk("Sync pulse group %u generated\n", group);
	return true;
}

static uint64_t group_average(const uint64_t *values, uint8_t group)
{
	uint64_t sum = 0U;
	const uint16_t first_id = group * EMG_SYNC_PULSES_PER_GROUP;

	for (uint8_t index = 0U; index < EMG_SYNC_PULSES_PER_GROUP; index++) {
		sum += values[first_id + index];
	}

	return sum / EMG_SYNC_PULSES_PER_GROUP;
}

static void report_calibration(void)
{
	const uint32_t expected_mask = BIT(EMG_SYNC_RECORD_COUNT) - 1U;
	uint64_t peripheral_start;
	uint64_t central_start;
	uint64_t peripheral_end;
	uint64_t central_end;
	uint64_t scale_q32;

	if (experiment_stats_count == 0U) {
		printk("E,experiment_stats_missing\n");
	} else {
		for (uint8_t index = 0U; index < experiment_stats_count;
		     index++) {
			const struct emg_experiment_stats *stats =
				&experiment_stats[index];

			printk("P,0x%02x,%u,%u,%u,%u,%u,%u,%u\n",
			       stats->config_id,
			       stats->generated_packets,
			       stats->enqueued_packets,
			       stats->transmitted_packets,
			       stats->queue_dropped_packets,
			       stats->stop_dropped_packets,
			       stats->send_error_packets,
			       stats->queue_high_watermark);
		}
	}

	if (received_sync_mask != expected_mask) {
		printk("E,sync_incomplete,0x%08x,0x%08x\n",
		       received_sync_mask, expected_mask);
		goto dump_data;
	}

	for (uint16_t pulse_id = 0U; pulse_id < EMG_SYNC_RECORD_COUNT;
	     pulse_id++) {
		printk("S,%u,%u,%llu,%llu\n", pulse_id,
		       pulse_id / EMG_SYNC_PULSES_PER_GROUP,
		       central_pulse_time_us[pulse_id],
		       peripheral_pulse_time_us[pulse_id]);

		if ((central_pulse_time_us[pulse_id] == 0U) ||
		    (peripheral_pulse_time_us[pulse_id] == 0U)) {
			printk("E,sync_missing_pulse,%u\n", pulse_id);
			goto dump_data;
		}
	}

	peripheral_start =
		group_average(peripheral_pulse_time_us, EMG_SYNC_GROUP_INITIAL);
	central_start =
		group_average(central_pulse_time_us, EMG_SYNC_GROUP_INITIAL);
	peripheral_end =
		group_average(peripheral_pulse_time_us, EMG_SYNC_GROUP_FINAL);
	central_end =
		group_average(central_pulse_time_us, EMG_SYNC_GROUP_FINAL);

	if (peripheral_end <= peripheral_start) {
		printk("E,sync_invalid_interval\n");
		goto dump_data;
	}

	scale_q32 = ((central_end - central_start) << 32) /
		    (peripheral_end - peripheral_start);

	printk("C,%llu,%llu,%llu,%llu,%llu\n",
	       peripheral_start, central_start, peripheral_end, central_end,
	       scale_q32);

dump_data:
	experiment_receiver_dump();
	printk("Session complete\n");
}

static void results_thread(void *p1, void *p2, void *p3)
{
	ARG_UNUSED(p1);
	ARG_UNUSED(p2);
	ARG_UNUSED(p3);

	while (true) {
		k_sem_take(&results_ready_sem, K_FOREVER);
		report_calibration();
	}
}

static void session_thread(void *p1, void *p2, void *p3)
{
	ARG_UNUSED(p1);
	ARG_UNUSED(p2);
	ARG_UNUSED(p3);

	while (true) {
		atomic_val_t generation;

		k_sem_take(&session_ready_sem, K_FOREVER);
		generation = atomic_get(&session_generation);
		memset(central_pulse_time_us, 0, sizeof(central_pulse_time_us));
		memset(peripheral_pulse_time_us, 0, sizeof(peripheral_pulse_time_us));
		memset(&experiment_stats, 0, sizeof(experiment_stats));
		experiment_stats_count = 0U;
		received_sync_mask = 0U;
		atomic_clear(&results_scheduled);

#if defined(CONFIG_EMG_PREEXPERIMENT) || defined(CONFIG_EMG_POSTEXPERIMENT)
		printk("Waiting %u s for BLE PHY, Data Length and connection parameters\n",
		       LINK_SETTLE_SECONDS);
		if (!sleep_checked(LINK_SETTLE_SECONDS * 1000U, generation)) {
			continue;
		}
		if (custom_client_print_link_state() != 0) {
			printk("E,link_state_unavailable\n");
			continue;
		}
#if defined(CONFIG_EMG_PREEXPERIMENT)
		printk("Session preparing: 10 initial pulses, saturation preexperiment, 10 final pulses\n");
#else
		printk("Session preparing: 10 initial pulses, 11 profiles x 20 s, 10 final pulses\n");
#endif
#else
		printk("Session preparing: 10 initial pulses, 60 s data, 10 final pulses\n");
#endif
		if (send_control_checked(EMG_CONTROL_PREPARE, generation) != 0 ||
		    !sleep_checked(SYNC_COMMAND_SETTLE_MS, generation) ||
		    !generate_pulse_group(EMG_SYNC_GROUP_INITIAL, generation)) {
			continue;
		}

		printk("Experiment started: duration=%u ms\n",
		       EXPERIMENT_DURATION_MS);
		if (send_control_checked(EMG_CONTROL_START_DATA, generation) != 0) {
			continue;
		}

		if (!sleep_checked(EXPERIMENT_DURATION_MS, generation) ||
		    send_control_checked(EMG_CONTROL_STOP_DATA, generation) != 0 ||
		    !sleep_checked(SYNC_COMMAND_SETTLE_MS, generation) ||
		    !generate_pulse_group(EMG_SYNC_GROUP_FINAL, generation) ||
		    send_control_checked(EMG_CONTROL_REPORT_SYNC, generation) != 0) {
			continue;
		}

		printk("Experiment stopped; waiting for synchronization records\n");
		if (sleep_checked(SYNC_REPORT_TIMEOUT_MS, generation) &&
		    !atomic_get(&results_scheduled)) {
			printk("E,sync_report_timeout\n");
			schedule_results_dump();
		}
	}
}

K_THREAD_DEFINE(sync_session_thread_id, 4096, session_thread,
		NULL, NULL, NULL, 6, 0, 0);
K_THREAD_DEFINE(results_dump_thread_id, 3072, results_thread,
		NULL, NULL, NULL, 7, 0, 0);

int sync_controller_init(void)
{
	int err;

	if (!gpio_is_ready_dt(&sync_gpio)) {
		return -ENODEV;
	}

	err = gpio_pin_configure_dt(&sync_gpio, GPIO_OUTPUT_INACTIVE);
	if (err) {
		return err;
	}

	printk("Sync output ready: ESP32-S3 GPIO4\n");
	return 0;
}

void sync_controller_session_ready(void)
{
	atomic_inc(&session_generation);
	k_sem_give(&session_ready_sem);
}

void sync_controller_disconnected(void)
{
	atomic_inc(&session_generation);
	gpio_pin_set_dt(&sync_gpio, 0);
}

bool sync_controller_process_notification(const uint8_t *data, uint16_t len)
{
	struct emg_experiment_stats stats;
	struct emg_sync_record record;

	if (emg_stats_record_decode(&stats, data, len) == 0) {
		if (experiment_stats_count < ARRAY_SIZE(experiment_stats)) {
			experiment_stats[experiment_stats_count++] = stats;
		} else {
			printk("E,experiment_stats_overflow,0x%02x\n",
			       stats.config_id);
		}
		return true;
	}

	if (emg_sync_record_decode(&record, data, len) != 0) {
		return false;
	}

	peripheral_pulse_time_us[record.pulse_id] = record.local_time_us;
	received_sync_mask |= BIT(record.pulse_id);

	if (received_sync_mask == (BIT(EMG_SYNC_RECORD_COUNT) - 1U)) {
		schedule_results_dump();
	}

	return true;
}
```

## src/sync_controller.h
```c
#ifndef SYNC_CONTROLLER_H_
#define SYNC_CONTROLLER_H_

#include <stdbool.h>
#include <stdint.h>

int sync_controller_init(void);
void sync_controller_session_ready(void);
void sync_controller_disconnected(void);
bool sync_controller_process_notification(const uint8_t *data, uint16_t len);

#endif /* SYNC_CONTROLLER_H_ */
```
